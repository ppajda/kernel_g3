## arch/arm/hotplug/Kconfig
```kconfig
menu "HotPlug Selection"

config MSM_HOTPLUG
	bool "MSM hotplug driver"
	depends on HOTPLUG_CPU
	default y
	help
	  The MSM hotplug driver controls on-/offlining of additional cores based
	  on current cpu load.

config ASMP
	bool "Multi-core automatic hotplug support"
	depends on SMP
	default y
	help
	  Automatically hotplugs the multiple cpu cores on and off
	  based on cpu load and suspend state

endmenu
```
